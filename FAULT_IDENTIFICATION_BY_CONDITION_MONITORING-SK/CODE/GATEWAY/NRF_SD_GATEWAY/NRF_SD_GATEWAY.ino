/**
 * @file GATEWAY.ino 
 * 
 * @brief  GATEWAY INO Programing File 
 *
 *  NOTE:- This Code will Work With ESP 8266 12-E
 *  
 *  
 *   This will Recevie data from On board System and then forward to Server over LAN 
 *  
 * 
 * 
 * @reference - https://easyeda.com/saikiran.sk1998/gateway-system
 *              https://arduino-esp8266.readthedocs.io/en/2.5.0/filesystem.html
 *              
 *              
 *              
 * @author SAIKIRAN BEHARA
 * @date 29-MARCH-2021
 *
 */


#include <SPI.h>
#include <SD.h>
#include <RF24.h>
#include <Wire.h>
#include <nRF24L01.h>
#include <Adafruit_GFX.h>
#include <Adafruit_SSD1306.h>
#include <ESP8266WiFi.h>


// CREATING OBJECT 

Adafruit_SSD1306 display(128, 64, &Wire, -1);
RF24 radio(2, 16); // CE, CSN
File myFile;


// VARIABLES 
boolean FILE_FLAG = false ;

uint16_t Input_Data[9] = { 0 } ;
String MSG_lv[6] = {"\0"};
char DATA[1024] = {NULL} ;
const char* ssid = "SAIKIRAN";
const char* password = "8879465001";
const char* host = "192.168.0.82";
const uint16_t port = 8282 ;
const byte address[6] = "00001";
uint16_t NUMBER_OF_PACKETS = 0 ,NUMBER_OF_PACKETS_ACK = 0  ;
char PREVIOUS_DATA[32] ={ NULL } , NEW_DATA[32] = {NULL} ,CMD[32] = {NULL} ,CMD_ACK[] = "OK" , CMD_ERROR[] = "TRANSMIT AGAIN";
bool META_FLAG = false ;
const unsigned char SK [] PROGMEM = {
0x00, 0x00, 0x00, 0x00, 0x00, 0x00, 0x00, 0x00, 0x00, 0x00, 0x00, 0x00, 0x00, 0x00, 0x00, 0x00, 
0x00, 0x00, 0x00, 0x00, 0x00, 0x00, 0x00, 0x00, 0x00, 0x00, 0x00, 0x00, 0x00, 0x00, 0x00, 0x00, 
0x00, 0x00, 0x00, 0x00, 0x00, 0x00, 0x00, 0x00, 0x00, 0x00, 0x00, 0x00, 0x00, 0x00, 0x00, 0x00, 
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0x00, 0x00, 0x00, 0x00, 0x00, 0x00, 0x00, 0x00, 0x00, 0x00, 0x00, 0x00, 0x00, 0x00, 0x00, 0x00
};

//FUNCTIONS 
void meta_data(void);
void RX_DATA(void);
void serial_terminal(String MSG);
// MAIN 

void setup() {
  
  // Open serial communications 
  Serial.begin(115200);
  Serial.println();

  
  // INIT OLED
  Serial.println("Initializing OLED...");
  if(display.begin(SSD1306_SWITCHCAPVCC, 0x3C)){
    Serial.println("Initialization Done .");
    display.clearDisplay();
    display.setTextSize(1);
    display.setTextColor(WHITE);
    display.display();
    display.drawBitmap(0,0,  SK, 128, 64, WHITE);
    display.display();
    for(int i =0 ; i < 128 ; i ++){
      display.fillRect(0,63,i,1,WHITE);
      display.display();
    }
    display.clearDisplay();
    
    display.display();
  }
  else 
    Serial.println("Allocation of OLED failed ");

  
  // INIT RADIO
  display.setCursor(0,10);
  display.print("INITIALIZING RADIO");
  display.display();
  Serial.println("Initializing Radio...");
  
  if(radio.begin()){
    display.setCursor(0,20);
    display.print("DONE !");
    display.display();
    Serial.println("Initialization Done !");
    radio.openReadingPipe(1, address);
    radio.setPALevel(RF24_PA_MIN);
    radio.setChannel(76);
    radio.setPayloadSize(32);
    radio.setAutoAck(true);
    radio.enableDynamicPayloads();
    radio.enableAckPayload ();
    //Set module as receiver
  //  radio.startListening();
  }
  else{
    display.setCursor(0,20);
    display.print("FAILED !");
    display.display();
    Serial.println("Initialization Failed !");
  }


  //INIT SD_CARD
  display.setCursor(0,30);
  display.print("INITIALIZING SD CARD");
  display.display();
  Serial.println("Initializing SD card...");
  if (SD.begin(0)) {
    display.setCursor(0,40);
    display.print("DONE !");
    display.display();
    Serial.println("Initialization Done !"); 
  }
  else {
    display.setCursor(0,40);
    display.print("FAILED !");
    display.display();
    Serial.println("Initialization Failed !");
  }
  display.clearDisplay();
  delay(800);
  display.display();

  //CONNECT TO AP
  display.setCursor(0,0);
  display.print("CONNECTING TO AP...");
  display.setCursor(0,10);
  display.print("SSID = ");
  display.print(ssid);
  display.setCursor(30,25);
  display.print("CONNECTING... ");  
  display.display();
  Serial.printf("Connecting to %s ", ssid);
  int x = 0 ; 

  WiFi.begin(ssid, password);
  while (WiFi.status() != WL_CONNECTED)
  { 
    display.fillRect(10,35,110,5,BLACK);
    display.drawRect(10,35,110,5,WHITE);
    display.fillRect(x,35,15,5,WHITE);
    display.fillRect(0,35,10,5,BLACK);
    display.fillRect(120,35,9,5,BLACK);
    display.display();
    x += 2;
    if (x >128)
    x = 0 ;
    Serial.print(".");
    delay(100);
  }   
  Serial.println(" connected");
  display.setCursor(35,45);
  display.print("CONNECTED !  ");
  display.setCursor(0,55);
  display.print("IP: ");
  display.print(WiFi.localIP());
  display.display();  
  Serial.println(WiFi.localIP());
//  gate = SD.open("HOLA.txt",FILE_WRITE); 
  display.clearDisplay();
  delay(2000);
  display.display();
  display.setTextWrap(false);
}
void loop() {
  // put your main code here, to run repeatedly:

  if(!SD.exists("GATEWAY_DATA.txt")){
    Serial.println("NO DATA ");
    RX_DATA();
  }
  else {
    int len = 0 ; 
    Serial.println("GOT_DATA");
    radio.stopListening();
    serial_terminal("STOP LISTENING");
    myFile = SD.open("GATEWAY_DATA.txt");
    WiFiClient client;
  if (myFile) {
    if (!client.connect(host, port)) {
        Serial.println("connection failed");
        delay(5000);
        return ;
  }    
  
    
    
    // read from the file until there's nothing else in it:
    while (myFile.available()) {
      Serial.println("GATEWAY_DATA.txt");
      if (myFile.available() < 1024){
        len = myFile.available() ;
      }
      else{
        len = sizeof(DATA);
      }
      DATA[1024] = {NULL} ;
      for (int i = 0 ; i < len ; i ++){
        DATA[i] = myFile.read();
        Serial.print(DATA[i]);
      }
      delay(100);

     if(client.connected()) {
      
      client.write(DATA);
      DATA[1024] = {NULL} ;
      delay(100);
     while (!client.available()){
      yield() ;
     }
     String line = client.readStringUntil('\r');
     Serial.println(line);
     Serial.println("line");
    delay(100);
    }
    }
    // close the file:
    client.print("close");
    client.stop();
    myFile.close();
    SD.remove("GATEWAY_DATA.txt");
    
  } else {
    // if the file didn't open, print an error:
    Serial.println("error opening test.txt");
  }
  }
  

  yield();

}


void meta_data(){
  
  CMD[32] = {NULL} ;
  NUMBER_OF_PACKETS = 0;
  
  while(true){
    radio.writeAckPayload( 1, &CMD_ACK, sizeof(CMD_ACK) );
    if(radio.available()){
      radio.read(&NUMBER_OF_PACKETS,sizeof(NUMBER_OF_PACKETS));
      if(NUMBER_OF_PACKETS > 0 ){
        delay(10);
        radio.flush_tx();
        break ;
      }
    }
    yield();
  }

  while(true){
    radio.writeAckPayload( 1, &NUMBER_OF_PACKETS, sizeof(NUMBER_OF_PACKETS) );
    if(radio.available()){
      radio.read(&CMD,sizeof(CMD));
      if(String(CMD) == "START"){
        delay(100);
        radio.flush_tx();
        break ;
      }
    }
    yield();
  }
}

void RX_DATA(){

  //SETUP
  radio.startListening();
  Serial.println("STARTED LISTENING");
  serial_terminal("STARTED LISTENING");

  while(true){

    NUMBER_OF_PACKETS = 0 ;
    CMD[32] = {NULL} ;

    if(META_FLAG == false){
    META_FLAG = true;
    meta_data();
  }

  if ((String(CMD) == "START") && (NUMBER_OF_PACKETS > 0)){

    
    META_FLAG = false;
    myFile = SD.open("GATEWAY_DATA.txt", FILE_WRITE);
    serial_terminal("PACKETS --> " + String(NUMBER_OF_PACKETS));

    Serial.println("STARTED_RECEIVING");
    serial_terminal("STARTED_RECEIVING");
    
    int PACKET_NUMBER = 1 ;

    if(myFile){
    
    while( PACKET_NUMBER <= NUMBER_OF_PACKETS ){
      
      radio.flush_tx();
      radio.writeAckPayload( 1, &PACKET_NUMBER, sizeof(PACKET_NUMBER) );
     
      if (radio.available()){
        radio.read(&NEW_DATA,sizeof(NEW_DATA));
         
        if ( String(NEW_DATA) != String(PREVIOUS_DATA)){
          myFile.print(NEW_DATA);
        /*  for(int i = 0; i < sizeof(NEW_DATA) ; i++ ){
            PREVIOUS_DATA[i] = NEW_DATA[i] ;
            //Serial.write(PREVIOUS_DATA[i]);  
          }*/
          NEW_DATA[32] = {NULL}; 
                                      // SAVE
          PACKET_NUMBER ++ ;
        }
     /*   else{
          PACKET_NUMBER ++;
        }*/
       radio.flush_rx();
      }
       yield();
      
    }
    serial_terminal("RECIVED_SUCCESSFULLY");
    myFile.close();
    break ;
  } 
  }
    yield();
  }
}

void serial_terminal(String MSG){
  int wt = 1 , ht = 4 ,dht = 10;

  display.clearDisplay();
  display.setCursor(40,1);
  display.print("TERMINAL");
  display.drawLine(0,11,128,11,1);
  display.display();
  
  MSG_lv[5] = "> " +  MSG ;
  for (int i = 0 ; i <= 5 ; i ++ ){
    MSG_lv[i] = MSG_lv[i+1]; 
  }
  for ( int j = 0 ; j <= 5 ; j ++){
    ht += dht;
  display.setCursor(wt, ht);
  display.print(MSG_lv[j]);
  display.display();
  }
  ht = 4 ;
}
