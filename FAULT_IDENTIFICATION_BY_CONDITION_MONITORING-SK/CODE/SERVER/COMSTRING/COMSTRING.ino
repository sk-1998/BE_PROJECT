
#include <SPI.h>
#include <Wire.h>
#include <Adafruit_GFX.h>
#include <Adafruit_SSD1306.h>


/* String HOSTNAME = {"\0"} , HOST_IP = {"\0"} , PORT = {"\0"} , \
       CPU = {"\0"} , RAM = {"\0"} , HDD = {"\0"} , N_W = {"\0"}; */

bool Flag = true ;
String PARA[7] = {"\0"};

Adafruit_SSD1306 display(128, 64, &Wire, -1);

void BlankPlace(int COLOR);
void ConsolDisplay(String MSG);
void SplitParameter(String DATA);
void Dispara();    
void structure();             


const unsigned char SK [] PROGMEM = {
0x00, 0x00, 0x00, 0x00, 0x00, 0x00, 0x00, 0x00, 0x00, 0x00, 0x00, 0x00, 0x00, 0x00, 0x00, 0x00, 
0x00, 0x00, 0x00, 0x00, 0x00, 0x00, 0x00, 0x00, 0x00, 0x00, 0x00, 0x00, 0x00, 0x00, 0x00, 0x00, 
0x00, 0x00, 0x00, 0x00, 0x00, 0x00, 0x00, 0x00, 0x00, 0x00, 0x00, 0x00, 0x00, 0x00, 0x00, 0x00, 
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0x00, 0x00, 0x00, 0x00, 0x00, 0x00, 0x00, 0x00, 0x00, 0x00, 0x00, 0x00, 0x00, 0x00, 0x00, 0x00
};


void setup() {
  // put your setup code here, to run once:
  Serial.begin(250000);
  display.begin(SSD1306_SWITCHCAPVCC, 0x3C);
  Serial.println("STARTED....");

  display.clearDisplay();
  display.setTextSize(1);
  display.setTextColor(WHITE);
  display.drawBitmap(0, 0,  SK, 128, 64, WHITE);
  display.display();

  delay(2000);
  int k = 0;

 while(true){

    if(Serial.available()){
      String CMD = Serial.readString();
      if(CMD.indexOf("OK") > -1 )
      break ; 
    }
    
    
    display.clearDisplay();
    display.setCursor(0,0);
    display.println(" WAITING FOR SERIAL ");
    display.setCursor(0,10);
    display.println(" PORT TO CONNECT");
    display.setCursor(0,20);
    display.println(" THE SYSTEM MIGHT  ");
    display.setCursor(0,30);
    display.println(" BOOTING...");
    display.setCursor(0,55);
    display.println(" BAUDRATE --> 115200"); 
  //  display.drawLine(0,40,128,40,WHITE); 
  //  display.drawLine(0,50,128,50,WHITE); 
    display.drawRoundRect(1, 40, 126, 10, 10, 1);
    display.fillRoundRect((k-40), 40, 50, 10, 10, 1);
    display.display();
    k+=4;
    if (k == (128+40))
    {
      k = 0; 
    }

}
structure();
ConsolDisplay("BOOTED SUCCESSFULLY");
delay(2000);
ConsolDisplay("LOADING DATA...");

  
}

void loop() {
  // put your main code here, to run repeatedly:

  if (Serial.available()){
    String IN = Serial.readString();
    if (IN.indexOf("CONSOL") > -1){
      int S = IN.indexOf("CONSOL") , C = IN.indexOf(":");
      IN.remove(S,(C-S)+1);
      ConsolDisplay(IN);
    }
    else if (IN.indexOf("PARA") > -1 ){
      int S1 = IN.indexOf("PARA") , C1 = IN.indexOf(":");
      IN.remove(S1,(C1-S1)+1);
      SplitParameter(IN);  
      Dispara();
    }
    else if (IN.indexOf("CLEAR") > -1 ){
      structure();
    }

    }

}

void SplitParameter(String DATA){
    for (int i = 0 ; i < 7 ; i ++){
      int start_index = 0 , end_index = DATA.indexOf(":");
      PARA[i] = DATA.substring(start_index, end_index );
      if( (i > 2) && (i < 6 ))
        PARA[i].concat(" %");
      DATA.remove(start_index,end_index + 1); 
    }
}


void ConsolDisplay(String MSG){
  display.fillRect(10, 52, 118, 10, 0); // CONSOL
  display.setCursor(13,54);
  display.println(MSG);
  display.display();
}

void BlankPlace(int COLOR){
      display.fillRect(58, 0, 70, 8, COLOR); // HOST NAME
      display.fillRect(46, 9, 82, 8, COLOR); // HOST IP
      display.fillRect(46, 19, 82, 8, COLOR); // PORT NO
      display.fillRect(22, 29, 40, 9, COLOR); // CPU 
      display.fillRect(86, 29, 40, 8, COLOR); // RAM
      display.fillRect(22, 39, 40, 8, COLOR); // HDD
      display.fillRect(86, 39, 40, 8, COLOR); // N/W
      display.display();
}

void Dispara(){
  BlankPlace(0);
  display.setCursor(60,0);
  display.println(PARA[0]);
  display.setCursor(48,10);
  display.println(PARA[1]);
  display.setCursor(48,20);
  display.println(PARA[2]);
  display.setCursor(24,30);
  display.println(PARA[3]);
  display.setCursor(88,30);
  display.println(PARA[4]);
  display.setCursor(24,40);
  display.println(PARA[5]);
  display.setCursor(88,40);
  display.println(PARA[6]);
    display.display();
}


void structure(){
  display.clearDisplay();
display.setCursor(0,0);
display.println("HOST NAME: ");
display.setCursor(0,10);
display.println("HOST IP:");
display.setCursor(0,20);
display.println("PORT NO:");
display.setCursor(0,30);
display.println("CPU: ");
display.setCursor(64,30);
display.println("RAM: ");
display.setCursor(0,40);
display.println("HDD: ");
display.setCursor(64,40);
display.println("CLT: ");
display.drawLine(0,50,128,50,WHITE);
display.setCursor(2,53);
display.println(">");
display.drawLine(0,63,128,63,WHITE);
display.display();

}
